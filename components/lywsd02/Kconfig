## components/lywsd02/Kconfig
```kconfig
menu "LYWSD02 Xiaomi E-Ink Clock Sensors"

    config LYWSD02_MAC_ADDR
        string "MAC Address"
        default "01:23:de:ad:be:ef"
        help
            Bluetooth MAC address of LYWSD02.

endmenu
```

## components/metrics/Kconfig
```kconfig
menu "OpenMetrics Exporter"

    config METRICS_HOSTNAME
        string "Hostname"
        default "esp-airsensor"
        help
            Device's hostname for networking. Maximum length 32 bytes.

    config METRICS_WIFI_SSID
        string "Wi-Fi SSID"
        help
            SSID of target AP. Maximum length 32 bytes.

    config METRICS_WIFI_PSK
        string "Wi-Fi Password"
        help
            PSK of target AP. Maximum length 64 bytes.

    config METRICS_HTTP_PATH
        string "HTTP Endpoint Path"
        default "/"
        help
            Put exporter on that page.

    config METRICS_MAX_ITEMS
        int "Maximum number of items"
        default 32
        range 1 65535
        help
           Buffer size of metric list in terms of item.

endmenu
```

## components/prometheus/Kconfig
```kconfig
menu "Prometheus Exporter"

    config PROMETHEUS_HOSTNAME
        string "Hostname"
        default "esp-airsensor"
        help
            Device's hostname for networking. Maximum length 32 bytes.

    config PROMETHEUS_WIFI_SSID
        string "Wi-Fi SSID"
        help
            SSID of target AP. Maximum length 32 bytes.

    config PROMETHEUS_WIFI_PSK
        string "Wi-Fi Password"
        help
            PSK of target AP. Maximum length 64 bytes.

endmenu
```

## components/sense_air_s8/Kconfig
```kconfig
menu "SenseAir S8 CO2 Sensor"

    config SENSE_AIR_S8_UART_PORT_NUM
        int "UART port number"
        range 0 2 if IDF_TARGET_ESP32 || IDF_TARGET_ESP32S3
        default 1 if IDF_TARGET_ESP32 || IDF_TARGET_ESP32S3
        range 0 1 if IDF_TARGET_ESP32S2 || IDF_TARGET_ESP32C3
        default 1 if IDF_TARGET_ESP32S2 || IDF_TARGET_ESP32C3
        help
            UART communication port number for SenseAir sensor.
            See UART documentation for available port numbers.

    config SENSE_AIR_S8_UART_RXD
        int "UART RXD pin number"
        range 0 34 if IDF_TARGET_ESP32
        range 0 46 if IDF_TARGET_ESP32S2 || IDF_TARGET_ESP32S3
        range 0 19 if IDF_TARGET_ESP32C3
        range 0 47 if IDF_TARGET_ESP32S3
        default 16
        help
            GPIO number for UART RX pin. See UART documentation for more information
            about available pin numbers for UART.

    config SENSE_AIR_S8_UART_TXD
        int "UART TXD pin number"
        range 0 34 if IDF_TARGET_ESP32
        range 0 46 if IDF_TARGET_ESP32S2 || IDF_TARGET_ESP32S3
        range 0 19 if IDF_TARGET_ESP32C3
        range 0 47 if IDF_TARGET_ESP32S3
        default 17
        help
            GPIO number for UART TX pin. See UART documentation for more information
            about available pin numbers for UART.

endmenu
```

## components/sensor/Kconfig
```kconfig
menu "SM300D2 Air Quality Sensor"

    config SENSOR_UART_PORT_NUM
        int "UART port number"
        range 0 2 if IDF_TARGET_ESP32 || IDF_TARGET_ESP32S3
        default 2 if IDF_TARGET_ESP32 || IDF_TARGET_ESP32S3
        range 0 1 if IDF_TARGET_ESP32S2 || IDF_TARGET_ESP32C3
        default 1 if IDF_TARGET_ESP32S2 || IDF_TARGET_ESP32C3
        help
            UART communication port number for the sensor.
            See UART documentation for available port numbers.

    config SENSOR_UART_RXD
        int "UART RXD pin number"
        range 0 34 if IDF_TARGET_ESP32
        range 0 46 if IDF_TARGET_ESP32S2 || IDF_TARGET_ESP32S3
        range 0 19 if IDF_TARGET_ESP32C3
        range 0 47 if IDF_TARGET_ESP32S3
        default 5
        help
            GPIO number for UART RX pin. See UART documentation for more information
            about available pin numbers for UART.

    config SENSOR_TASK_STACK_SIZE
        int "Sensor task stack size"
        range 1024 16384
        default 2048
        help
            Defines stack size for the sensor. Insufficient stack size can cause crash.

endmenu
```

## components/sm300d2/Kconfig
```kconfig
menu "SM300D2 Air Quality Sensor"

    config SM300D2_UART_PORT_NUM
        int "UART port number"
        range 0 2 if IDF_TARGET_ESP32 || IDF_TARGET_ESP32S3
        default 2 if IDF_TARGET_ESP32 || IDF_TARGET_ESP32S3
        range 0 1 if IDF_TARGET_ESP32S2 || IDF_TARGET_ESP32C3
        default 1 if IDF_TARGET_ESP32S2 || IDF_TARGET_ESP32C3
        help
            UART communication port number for SM300D2 sensor.
            See UART documentation for available port numbers.

    config SM300D2_UART_RXD
        int "UART RXD pin number"
        range 0 34 if IDF_TARGET_ESP32
        range 0 46 if IDF_TARGET_ESP32S2 || IDF_TARGET_ESP32S3
        range 0 19 if IDF_TARGET_ESP32C3
        range 0 47 if IDF_TARGET_ESP32S3
        default 5
        help
            GPIO number for UART RX pin. See UART documentation for more information
            about available pin numbers for UART.

    config SM300D2_TASK_STACK_SIZE
        int "Task stack size"
        range 1024 16384
        default 2048
        help
            Defines stack size for SM300D2 sensor. Insufficient stack size can cause crash.

    config SM300D2_AGGREGATION_SECS
        int "Aggregation period (seconds)"
        range 1 3600
        default 10
        help
            Emit one data point every such seconds. Arithmetic mean of points within the period.

endmenu
```
